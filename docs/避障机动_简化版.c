/* =====================================================================
 * 避障模块 —— 简化讲解版（C18：红外触发改为"倒车 + 右转"避让）
 *
 *   ⚠️ 这不是编译单元，只用来把逻辑看全。
 *      电机动作在这里写成 M_*() 这种直白名字，实际固件对应的是统一出口
 *      motor_set(动作码, 档位)；真正的实现在 firmware\c51\main.c 的
 *      「C18 避障机动」一节（av_mnv_start / av_mnv_step），
 *      并靠 motor_set_core 里的闸门把动作改写成倒车 / 原地右转。
 *
 *   本轮改动（老师要求）：
 *     原来：车头红外被触发 -> 就地刹车 + 锁存，等遥控来救。
 *     现在：车头红外被触发 -> ① 自动倒车让出转弯空间
 *                          ② 倒够了就原地右转绕开
 *                          ③ 转完交回正常避障流程接着走。
 *
 *   本轮改动之二（C19，老师反馈：超声波分级的演示效果不明显）：
 *     原来"量程上限"就写在 US_NEAR 上（21cm）—— 中断数回波数到 21cm 就收手、
 *     一律报 US_FAR，于是"21cm 以外有东西"和"前方没东西"是同一个值，
 *     整套分级全挤在最后 21cm 里；而车头只要偏一点点，正向距离就超过
 *     21cm，立刻被当成"已经让开"而回正 —— 表现就是"转一下就很快直回来"。
 *     现在：量程独立成 US_RANGE（77cm）、介入距离 US_NEAR = 24cm，
 *     退出要退到 US_REL = 69cm 才认（滞回）。
 *
 *   本轮改动之三（C20，老师要求：红外倒车避让不用超声传感器）：
 *     倒车段改成**固定时长** AV_BACK_TICKS ≈ 1.0s，不再读超声距离 ——
 *     车头正贴着障碍时超声本来就读不出数（模块最小量程约 2cm），
 *     原来那条"按距离判退够没有"的路从来没走通过，实际每次都靠兜底收场。
 *
 *   本轮改动之四（C21，上机反馈：触发时只停车、显示 0，要按一下键才退）：
 *     根因是机动**依赖了用户档位**：挂在 0 档（数码管显示 0）时
 *     motor_set(_, 0) 在 motor_set_core 第一行就 return（g==0 -> DIR_STOP），
 *     车一步都不动；再加上"车本来在动才倒车"这条守卫，就直接被拦成刹停锁存。
 *     现在：机动自带倒车档位（AV_BACK_GEAR）、红外一触发就机动，
 *     倒车时长同时从 1.0s 缩到 0.5s。
 * ===================================================================== */
#include <reg52.h>
#include "motor.h"

/*---------------- 距离阈值（1 tick ≈ 1.72cm）----------------
 *   ★C19：顺序必须保持 US_STOP < AV_SPIN < US_NEAR < US_REL < US_RANGE。
 *   US_RANGE 是"量程上限"，中断里数回波就数到这里（简化版里假定
 *   us_read() 内部已经按它收手），所以它必须 >= US_REL，否则滞回门限量不到。 */
#define US_RANGE      45     /* 量程上限 ≈ 77cm（★必须 >= US_REL）*/
#define US_REL        40     /* 退出避让的滞回门限 ≈ 69cm */
#define US_NEAR       14     /* < 24cm ：弧线右绕（进入"小弯"的判断距离）*/
#define AV_SPIN       10     /* < 17cm ：原地右转避让（现场要求 18cm 左右，取 10 tick）*/
#define US_STOP       3      /* < 5cm  ：太近 -> 刹停锁存 */
#define US_CLEAR      7      /* 7 tick ≈ 12cm：锁存期间判"障碍退远"用 */
#define US_FAR        0xFF   /* 没回波 / 超过量程 -> 当作"够远"，别当 0 处理！ */

/*---------------- 避障闸门状态 ----------------*/
#define AV_FREE       0      /* 放行：无障碍 */
#define AV_TURN       1      /* 近区：原地右转避让 */
#define AV_HOLD       2      /* 太近：刹停 + 锁存，决定权交给遥控 */
#define AV_ARC        4      /* 中区：弧线右绕，车不停 */
#define AV_BACK       5      /* ★C18 机动①：自动倒车，让出转弯空间 */
#define AV_ATURN      6      /* ★C18 机动②：原地右转让开 */

/*---------------- C18 机动参数 ----------------*/
#define AV_MNV_MOVING  0         /* ★C21：0 = 红外一触发就倒车，不管车本来在不在动。
                                  * 上机反馈"触发时只停车不倒车、要按一下键才退"，
                                  * 就是这项（加上档位 0）拦掉的。改回 1 = 停着不倒车 */
#define AV_BACK_GEAR   BACK_GEAR_MAX
                                 /* ★C21：机动倒车**自带档位**，不看用户档位。
                                  * 原来传 gear：挂 0 档时 M_Back(0) 就是停车、一步不动，
                                  * 挂 1 档（40%）又倒得极慢。现在与用户档位彻底脱钩 */
#define AV_TURN_GEAR   (gear ? gear : GEAR_DEFAULT)
                                 /* 转弯段跟用户档位；0 档时补默认档，保证一定能转 */
#define AV_BACK_TICKS  5000      /* ★C21 倒车段固定 5000 tick ≈ 0.5s（C20 是 1.0s，改短）*/
#define AV_TURN_TICKS  10000     /* ★C23 转弯段 10000 tick ≈ 1.0s（原 0.3s 只转 20~40°，
                                  * 视觉上像"点一下"，看不出在转弯避障）*/
#define AV_MNV_MAX     3         /* ★C24 一次遇到障碍最多连做 3 轮"倒车 + 转弯"，
                                  * 3 轮还绕不开（对着一面墙）才刹停锁存等遥控 */
#define AV_OFF_IN_LIGHT 1        /* ★C25 1 = 寻光模式下**所有避障关掉**（超声波分级 +
                                  * 车头红外倒车机动 + 近距提示音），寻光只管追光跑；
                                  * 0 = 寻光也照常避障 */

sbit IR_AVOID = P3^7;

/*---------------- 状态变量 ----------------*/
unsigned char avst;          /* 避障闸门状态 AV_* */
bit us_avoid_on;             /* 超声波避障开关，1 开 0 关 */
bit av_mnv;                  /* ★C18：机动（倒车 + 右转）正在进行 */
unsigned int mnv_t0;         /* ★C18：本段机动的起始时刻（实机复用 back_t0）*/
unsigned char av_rnd;        /* ★C24：本次遭遇已经做过几轮机动（实机借用 av_beep_n，
                              * 省下直接寻址区最后那 1 字节）*/

/*
函数：ir_det()
功能：读车头红外 P3^7，判断是否已经贴上东西
返回：1 = 贴上，0 = 没东西
注意：★C22 极性**写死为"低电平表示检测到"**（实机 IR_INV_FORCE = 0）。
      原来实机是"上电读一次 P3.7 当基准自动校准"，结果某次冷启动时车头
      正好有东西，基准被定反、整个避障翻了过来 —— 障碍在跟前不躲、拿开
      反而倒车、收场还误锁存导致车再也不往前。写死之后与上电状态无关。
*/
bit ir_det(void)
{
    if(IR_AVOID)
        return 1;
    return 0;
}

/*
函数：avoid_off()
功能：超声波这一路现在参不参与
返回：1 = 不参与；0 = 参与
注意：实际固件里"正在录制"也算不参与（录制要忠实记人的操作），
      这里为了简化没写进去。
*/
bit avoid_off(void)
{
    if(us_avoid_on == 0)
        return 1;
    return 0;
}

/*------------------------------------------------------------------
函数：av_mnv_start()  ★C18 机动启动
功能：车头红外贴上了，开始"倒车 + 右转"避让
说明：车尾没有任何传感器，倒车这一段软件看不见后面，所以有三道闸 ——
      ① 倒车段 ★C20 起是**固定时长**（AV_BACK_TICKS ≈ 0.5s），到点无条件
         改转弯；这一段不拿超声做判断 —— 车头正贴着障碍时超声读不出数，
         原来那条"按距离判退够没有"的路从来没走通过；
      ② ★C24：一次遭遇最多连做 AV_MNV_MAX(=3) 轮，超过才锁存 ——
         否则碰上一面墙会"退—转—退—转"无限循环；
      ③ ★C21：红外一触发就机动，不再要求"车本来在动"（上机反馈
         "触发时只停车不倒车"就是这条守卫拦的）；想改回去把
         AV_MNV_MOVING 设成 1。倒车用机动自带档位 AV_BACK_GEAR。
------------------------------------------------------------------*/
void av_mnv_start(void)
{
#if AV_MNV_MOVING
    if(cur_act == 0 || gear == 0)   /* 本来就没在动 -> 不乱窜 */
    {
        avst = AV_HOLD;             /* 刹停 + 锁存，等遥控 */
        M_Stop();
        return;
    }
#endif

    /* ★C24：录制中不做机动 —— 录制要忠实记人的操作，红外只保留"贴上就刹车" */
    if(recon)
    {
        avst = AV_HOLD;
        M_Stop();
        return;
    }

    av_mnv  = 1;
    avst    = AV_BACK;              /* 阶段直接记在 avst 上 */
    mnv_t0  = tick_get();
    av_rnd  = 0;                    /* ★C24 本次遭遇的轮次从 0 起算 */
    M_Back(AV_BACK_GEAR);           /* 倒车：机动自带档位（实机限速最高 2 档）*/
}

/*------------------------------------------------------------------
函数：av_mnv_step()  ★C18 机动步进：倒车 -> 右转 -> 收场
功能：机动期间每趟主循环调一次，自己管自己的时序
说明：期间不看传感器 —— 否则红外还贴着会一趟一趟重启机动。
------------------------------------------------------------------*/
void av_mnv_step(void)
{
    unsigned int el = tick_get() - mnv_t0;

    /* ★C20：不拿超声做判断，但每趟仍踢一脚测距把结果丢掉 ——
     *   收场后 av_gate 立刻要按距离分档，us_read() 在两次测距之间是
     *   "沿用上次结果"的，整段机动不测就会交出"贴着障碍时"那份旧值，
     *   被误判成"太近"直接刹停锁存（手动模式不会自解）。 */
    us_read();

    if(avst == AV_BACK)
    {
        /* ---- ① 倒车段：★C20 固定倒 AV_BACK_TICKS（0.5s），不拿超声做判断 ----
         *   车头正贴着障碍时超声读不出数（最小量程约 2cm），
         *   按距离判"退够了没有"是死路，所以改成纯计时。 */
        if(el >= AV_BACK_TICKS)
        {
            avst   = AV_ATURN;      /* 倒够了 -> 换转弯段 */
            mnv_t0 = tick_get();
            M_Spin();               /* 原地右转 */
            return;
        }
        M_Back(AV_BACK_GEAR);       /* 还没倒够，接着倒（机动自带档位）*/
        return;
    }

    /* ---- ② 转弯段：原地右转一小会儿 ---- */
    if(el < AV_TURN_TICKS)
    {
        M_Spin();
        return;
    }

    /* ---- ③ 收场：这一轮走完了，看还要不要再来一轮（★C24 方案 B）---- */
    if(ir_det())                    /* 转完还贴着 */
    {
        av_rnd++;
        if(av_rnd < AV_MNV_MAX)     /* 还有余量 -> 回到倒车段再来一轮 */
        {
            avst   = AV_BACK;
            mnv_t0 = tick_get();
            M_Back(AV_BACK_GEAR);
            return;                 /* 注意：av_mnv 保持 1，机动不结束 */
        }
        av_mnv = 0;                 /* 轮次用完 -> 刹停锁存等遥控 */
        avst = AV_HOLD;
        M_Stop();
        return;
    }
    av_mnv = 0;
    av_rnd = 0;
    avst = AV_FREE;                 /* 交回正常流程：
                                     * 下一趟按距离重新分档，通常就是"放行直行" */
}

/*
函数：av_gate() 避障核心闸门，主循环反复调用
功能：读传感器，根据距离修改 avst，并驱动电机
*/
void av_gate(void)
{
    unsigned char d;

    /* ★C25 寻光模式：所有避障关闭。
     *   放在最前面（连机动早退之前），所以切到寻光那一瞬间正在跑的
     *   倒车 + 转弯也会就地取消，avst 清成 AV_FREE 顺便解掉锁存。 */
#if AV_OFF_IN_LIGHT
    if(mode == MODE_LIGHT)
    {
        av_mnv = 0;
        avst   = AV_FREE;
        return;
    }
#endif

    /* 0. ★C18 机动进行中：最高优先级，时序自己管 */
    if(av_mnv)
    {
        av_mnv_step();
        return;
    }

    /* 1. 超声波不参与时，顺手把旧的锁存解开 */
    if(avoid_off() && avst == AV_HOLD)
    {
        avst = AV_FREE;
    }

    /* 2. 锁存态：保持停车，等遥控/按键来解除
     *    ★"锁存"的含义就是：障碍自己挪开了车也不走，必须人来按一下。
     *      所以这里必须提前 return —— 不然后面重新分档会把锁存放行掉，
     *      "锁存"就名不副实了。 */
    if(avst == AV_HOLD)
    {
        M_Stop();
        return;
    }

    /* 3. ★C18 车头红外：触发"倒车 + 右转"机动（原来这里是直接刹车）*/
    if(ir_det())
    {
        av_mnv_start();
        return;
    }

    /* 4. 倒车时超声波不参与：它朝前，倒车时读数没意义 */
    if(cur_act == ACT_BACK)
    {
        avst = AV_FREE;
        M_Back(gear);               /* 把可能残留的"原地右转"改写回来 */
        return;
    }

    /* 5. 避障关掉 -> 放行 */
    if(avoid_off())
    {
        avst = AV_FREE;
        return;
    }

    /* 6. 读超声波距离 d：数值越小距离越近 */
    d = us_read();

    /* 7. 距离小于 5cm，太近 -> 锁存停车 */
    if(d < US_STOP)
    {
        avst = AV_HOLD;
        M_Stop();
        return;
    }

    /* 8. 分档（17~24cm 弧线，车不停；5~17cm 原地右转；够远放行）*/
    if(d < AV_SPIN)
    {
        avst = AV_TURN;
        M_Spin();
    }
    else if(d < US_NEAR)
    {
        avst = AV_ARC;
        M_RightSmall();
    }
    /* ★C19：退出避让要带滞回 —— 进入看 US_NEAR(24cm)，退出要退到
     * US_REL(69cm) 才算真让开。不加这一段的话，正向距离刚过 24cm 就
     * 立刻回正，弧线走不完整，看着就是"转一下就很快直回来"。 */
    else if(avst == AV_FREE || d >= US_REL)
    {
        avst = AV_FREE;
        M_Forward();
    }
    else
    {
        avst = AV_ARC;       /* 24~69cm 这条滞回带：接着绕，别急着回正 */
        M_RightSmall();
    }
}

/*
函数：avoid_toggle()
功能：切换超声波避障开关状态，按键/遥控调用
说明：机动进行中不打断 —— 红外这一路本来就是关不掉的，
      让它自己跑完（全程约 1 秒）。
*/
void avoid_toggle(void)
{
    us_avoid_on = !us_avoid_on;
    if(us_avoid_on == 0 && av_mnv == 0)
    {
        avst = AV_FREE;   /* 关闭避障，清除锁存 */
    }
}

/*
初始化避障模块，main 中调用一次
*/
void Avoid_Init(void)
{
    us_avoid_on = 1;     /* 上电默认打开超声波避障 */
    avst = AV_FREE;      /* 上电默认放行，无障碍物 */
    av_mnv = 0;          /* 上电不在机动中 */
}
