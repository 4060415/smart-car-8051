/*=========================================================================
 * 前进/后退演示程序 fwd_back.c
 * 姓名：李家乐　　学号：03231312
 *=========================================================================*/

/*==========================================================================
 * fwd_back.c  --  最简「前进 / 后退」演示程序
 *--------------------------------------------------------------------------
 * 芯片   : STC89C52RC，晶振 11.0592 MHz
 * 功能   : 上电后自动循环，一直跑，不需要遥控器，也不需要任何传感器。
 *
 *              前进 2 秒 -> 停车 0.5 秒 -> 后退 2 秒 -> 停车 0.5 秒 -> 回到开头
 *
 * 硬件引脚（唯一事实源是 firmware/car/config.h）
 *      P0.0 = IN1        P0.2 = IN3        P0.4 = ENA（高 = 使能左轮）
 *      P0.1 = IN2        P0.3 = IN4        P0.5 = ENB（高 = 使能右轮）
 *      P0.6 = 蜂鸣器（1 = 静音，所以恒写 1）
 *      P0.7 = 未使用，恒写 1（P0 是开漏口）
 *
 * 电机怎么转（L293D 的真值表）
 *      前进 = IN1 和 IN3 同时给高，P0 低 4 位 = 0x05
 *      后退 = IN2 和 IN4 同时给高，P0 低 4 位 = 0x0A
 *      停车 = 四个方向位全 0
 *   把 P0 整字节写出来（0x80 恒 1 + 方向 + 0x10 左轮使能 + 0x20 右轮使能
 *   + 0x40 静音）就是：
 *      前进 = 0xF5        后退 = 0xFA        停车 = 0xC0
 *
 * 注意：本程序不做 PWM 调速，两个轮子都是全速（占空比 100%）。
 *       觉得太快就先把 RUN_MS 调小，还嫌快见文件最后的「调速」一段。
 *==========================================================================*/

#include <reg52.h>

/* ---- 三个电机指令（P0 整字节值） ---- */
#define M_FORWARD   0xF5        /* 0x80 | 0x05 | 0x10 | 0x20 | 0x40 -> 前进 */
#define M_BACK      0xFA        /* 0x80 | 0x0A | 0x10 | 0x20 | 0x40 -> 后退 */
#define M_STOP      0xC0        /* 方向位全 0，两个使能也拉低     -> 停车 */

/* ---- 动作时长（毫秒） ---- */
#define RUN_MS      2000        /* 前进 / 后退 各走多久 */
#define PAUSE_MS     500        /* 换方向前先停多久 */

/*--------------------------------------------------------------------------
 * 软件延时，一轮约 1 毫秒（一轮 = 传进来的 ms 减 1）
 *   11.0592 MHz 下一个机器周期是 12/11.0592 = 1.085 微秒，
 *   1 毫秒 = 921.6 个机器周期。
 *
 *   这里的 3 和 96 不是随便写的：编译完对着生成的汇编数过周期 ——
 *   内层 for (j = 0; j < 96; j++) 编成 INC + CJNE 两条，正好 3 个机器周期，
 *   乘 96 得 288；外层和内层的判断、跳转再加 20 个周期，
 *   一整轮 = 3 x (7 + 2 + 288 + 5) + 8 + 3 + 7 = 924 个机器周期
 *        = 924 x 1.085 = 1003 微秒 ≈ 1 毫秒。
 *   （原来的 200 是一轮 1860 周期 ≈ 2 毫秒，2 秒就会拖成 4 秒，所以改成 96。）
 *
 *   它是软件延时，不如定时器准，但它不占用定时器、不引入中断，
 *   做「前进几秒、后退几秒」的演示绰绰有余。
 *--------------------------------------------------------------------------*/
static void delay_ms(unsigned int ms)
{
    unsigned int  i;
    unsigned char j;

    while (ms--) {
        for (i = 0; i < 3; i++)
            for (j = 0; j < 96; j++)
                ;
    }
}

/*--------------------------------------------------------------------------
 * 主程序
 *   P0 只有这一处写，写完就延时，所以主循环里等于是"一句话一个动作"，
 *   老师对着代码看就能一眼看出前进、后退对应哪一行。
 *--------------------------------------------------------------------------*/
void main(void)
{
    P0 = M_STOP;                /* 上电先停车：中断还没开，此刻直接写 P0 是安全的 */

    while (1) {
        P0 = M_FORWARD;         /* 前进 */
        delay_ms(RUN_MS);

        P0 = M_STOP;            /* 停车，换方向前给电机留一点时间 */
        delay_ms(PAUSE_MS);

        P0 = M_BACK;            /* 后退 */
        delay_ms(RUN_MS);

        P0 = M_STOP;            /* 停车，然后从头再来 */
        delay_ms(PAUSE_MS);
    }
}

/*==========================================================================
 * 调速（可选，不改也能验收）
 *   本程序是全速跑，不需要调速时上面就是全部代码。
 *   想慢一点：把 ENA / ENB 改成用方波开关，也就是 PWM。
 *   做法是让定时器每 500 微秒打断一次，中断里数 20 步为一个周期（10 毫秒，
 *   即 100 Hz），占空比想给 40% 就让 ENA 在前 8 步为高。
 *   现成的实现（含档位表 40/55/70/85/100%）在 firmware/c51/main.c 的
 *   Timer0 中断里，需要时再照搬，本演示程序不引入中断，保持最简单。
 *==========================================================================*/
