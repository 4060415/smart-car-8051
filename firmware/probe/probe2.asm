;=========================================================================
; probe2.asm  --  引脚识别程序（"自报序号"版）
;-------------------------------------------------------------------------
; 目标器件 : STC89C52RC
; 生成工具 : Keil A51 + BL51 + OH51   (build.ps1 -Name probe2)
;-------------------------------------------------------------------------
; 跟 probe.asm 的区别
;   probe.asm   : 按 24 个时间片轮流让每个引脚动 4 秒, 你要"数第几片", 容易错。
;   probe2.asm  : 第 i 个引脚就抽动 i 下。你只要**数电机抽了几下**,
;                 不用盯时间、不用数时间片, 一眼就知道是第几位。
;
; 运行流程（上电后自动无限循环）
;   1) 起始标记: P1 和 P2 全部引脚一起翻转 3 次
;      -> 两个轮子各抽 3 下。既证明程序在跑, 也证明两个电机都活着。
;   2) 静默约 3 秒
;   3) 【P1 组】
;        a. 组标记: P1 全部引脚一起翻转 2 次
;           -> 若两个轮子各抽 2 下, 说明电机就接在 P1 口上, 这组就是你要的。
;              (接在别的口上的器件不会动)
;        b. 静默约 3 秒
;        c. P1.0 抽 1 下 -> 停 2.5 秒 -> P1.1 抽 2 下 -> 停 2.5 秒
;           -> ... -> P1.7 抽 8 下
;   4) 静默约 4 秒
;   5) 【P2 组】 同样结构: 组标记 2 下, 然后 P2.0 抽 1 下 ... P2.7 抽 8 下
;   6) 静默约 4 秒
;   7) 【P0 组】 同样结构: 组标记 2 下, 然后 P0.0 抽 1 下 ... P0.7 抽 8 下
;      注意: P0 是开漏口, 写 1 只是"放开"(靠外部上拉), 所以只有**低电平有效**
;      的负载会响应(共阳数码管的段、PNP 驱动的蜂鸣器都属于这类)。
;      高电平有效的负载接在 P0 上时不会动, 属正常, 不要据此判虚焊。
;   8) 静默约 4 秒, 回到 (1) 重新开始
;
; 怎么读结果（关键）
;   * "抽 i 下" 就是第 i 位(bit i-1)。比如左轮抽了 3 下 -> 接在 P1.2。
;   * 同一个轮子**可能在相邻两位都抽动**, 而且次数正好是相邻的两个数
;     (例如抽 3 下和抽 4 下)。这是正常的, 也是有用的信息:
;     这两根就是该电机的两个方向脚(IN1/IN2), 属于同一路 H 桥。
;   * 组标记(该口全部引脚一起动 2 下)是分组的依据:
;     哪个组的组标记能让某个器件动, 这个器件就在哪个口上。
;       组标记后第 1 组 = P1, 第 2 组 = P2, 第 3 组 = P0。
;   * 数码管某段闪、蜂鸣器"哒哒"响, 同样按"响几下/闪几下"来定位引脚。
;
; 安全说明
;   * P3 口完全不碰: P3.0/P3.1 是 CH340 下载串口, P3.2 接 0038 红外接收头输出,
;     对外驱动会与接收头输出级抢电流。
;   * 抽动是 4Hz 左右的正反抖动, 不会损坏 L293D 或电机。测试时把小车架起来,
;     让轮子悬空。
;=========================================================================

;-------------------------------------------------------------------------
; 寄存器分配
;   R7 : 当前引脚位掩码 (01H,02H,...80H)
;   R6 : 端口号 (0=P0, 1=P1, 2=P2)
;   R5 : "目标位为低、其余位为高"的输出图案
;   R4 : SILENCE 等延时的半周期计数
;   R3 : 当前引脚应有的抽动次数 (1..8)
;   R0 : 抽动次数循环计数
;   R1,R2 : D_HALF 延时用
;-------------------------------------------------------------------------

            ORG     0000H
            LJMP    MAIN

            ORG     0030H
;=========================================================================
; 主程序
;=========================================================================
MAIN:
            MOV     SP,     #60H
            MOV     P0,     #0FFH           ; P0 开漏, 写 1 = 放开
            MOV     P1,     #0FFH
            MOV     P2,     #0FFH

ROUND:
            ;---- 起始标记: 两个口一起翻转 3 次(两个轮子各抽 3 下) ----
            MOV     R4,     #3
SIG_ALL:
            MOV     P1,     #00H
            MOV     P2,     #00H
            ACALL   D_PULSE
            MOV     P1,     #0FFH
            MOV     P2,     #0FFH
            ACALL   D_PULSE
            DJNZ    R4,     SIG_ALL
            MOV     R4,     #8
            ACALL   SILENCE                 ; 静默约 3 秒

            MOV     R6,     #1              ; ---- P1 组 ----
            ACALL   PORT_GROUP
            MOV     R4,     #10
            ACALL   SILENCE                 ; 静默约 4 秒

            MOV     R6,     #2              ; ---- P2 组 ----
            ACALL   PORT_GROUP
            MOV     R4,     #10
            ACALL   SILENCE                 ; 静默约 4 秒

            MOV     R6,     #0              ; ---- P0 组 (开漏, 只能看低电平有效的负载) ----
            ACALL   PORT_GROUP
            MOV     R4,     #10
            ACALL   SILENCE
            SJMP    ROUND                   ; 无限循环

;=========================================================================
; PORT_GROUP: 先做组标记, 再让该口 8 个引脚分别抽动 1..8 下
;   入口: R6 = 端口号      出口: 无
;=========================================================================
PORT_GROUP:
            ;---- 组标记: 该口全部引脚一起翻转 2 次 ----
            MOV     R4,     #2
PG_MARK:
            MOV     A,      #00H
            ACALL   PORT_OUT
            ACALL   D_PULSE
            MOV     A,      #0FFH
            ACALL   PORT_OUT
            ACALL   D_PULSE
            DJNZ    R4,     PG_MARK
            MOV     R4,     #6
            ACALL   SILENCE                 ; 静默约 2.3 秒

            ;---- 逐位: 第 i 位抽动 i 下 ----
            MOV     R7,     #01H            ; 位掩码从 bit0 开始
            MOV     R3,     #1              ; 抽动次数从 1 开始
PG_BIT:
            MOV     A,      #0FFH
            XRL     A,      R7              ; 目标位为 0, 其余为 1
            MOV     R5,     A
            MOV     A,      R3
            MOV     R0,     A               ; R0 = 本引脚要抽动的次数
PG_PULSE:
            MOV     A,      R5
            ACALL   PORT_OUT                ; 目标位拉低 -> 电机抽一下
            ACALL   D_PULSE
            MOV     A,      #0FFH
            ACALL   PORT_OUT                ; 目标位放开 -> 停
            ACALL   D_PULSE
            DJNZ    R0,     PG_PULSE

            MOV     R4,     #5
            ACALL   SILENCE                 ; 位与位之间静默约 1.9 秒

            MOV     A,      R7
            RL      A                       ; 掩码左移
            MOV     R7,     A
            INC     R3
            CJNE    R3,     #9,     PG_BIT  ; 1..8 走完(R3=9)则结束
            RET

;=========================================================================
; PORT_OUT: 把 A 写到 R6 指定的端口 (不能对 SFR 用 @R0 间接寻址)
;   A 与 R0~R7 均不被破坏
;=========================================================================
PORT_OUT:
            CJNE    R6,     #0,     PO_P1
            MOV     P0,     A
            RET
PO_P1:
            CJNE    R6,     #1,     PO_P2
            MOV     P1,     A
            RET
PO_P2:
            MOV     P2,     A
            RET

;=========================================================================
; SILENCE: P1/P2 置"不动作"电平, 持续 R4 个 D_HALF
;   入口 R4 = 半周期数, 出口 R4 = 0
;=========================================================================
SILENCE:
SIL_LOOP:
            MOV     P0,     #0FFH
            MOV     P1,     #0FFH
            MOV     P2,     #0FFH
            ACALL   D_HALF
            DJNZ    R4,     SIL_LOOP
            RET

;=========================================================================
; D_PULSE: 一次抽动的半周期, 约 250ms
; D_HALF : 基本半周期, 12MHz 晶振下约 125ms
;   两者只使用 R1/R2, 不破坏其它寄存器
;=========================================================================
D_PULSE:
            ACALL   D_HALF
            ACALL   D_HALF
            RET

D_HALF:
            MOV     R1,     #250
DH1:
            MOV     R2,     #250
DH2:
            DJNZ    R2,     DH2             ; 250 * 2us = 500us
            DJNZ    R1,     DH1             ; 250 * ~504us = 126ms
            RET

            END
