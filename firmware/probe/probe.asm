;=========================================================================
; probe.asm  --  智能移动机器人主板 "引脚探测" 自检程序
;-------------------------------------------------------------------------
; 目标器件 : STC89C52RC (8051 内核, 12MHz 晶振)
; 生成工具 : Keil A51 + BL51 + OH51  (调用 build.ps1)
; 烧录工具 : STC-ISP + CH340 串口
;-------------------------------------------------------------------------
; 这个程序做什么
;   复位后自动按顺序给每一个 I/O 引脚输出 4Hz 方波, 每脚持续约 4 秒,
;   脚与脚之间静默 2 秒。顺序:
;       P0.0 P0.1 ... P0.7  ->  P1.0 ... P1.7  ->  P2.0 ... P2.7
;   24 个引脚走完后回到起点, 无限循环, 不需要重上电就能重复观察。
;
; 怎么用它找接线
;   复位后先静默 3 秒作为"起始标记", 然后开始第 1 片(P0.0)。
;   哪个器件在第 n 个时间片动作, 它就接在序列里的第 n 个引脚:
;       第 1~8   片 -> P0.0 ~ P0.7
;       第 9~16  片 -> P1.0 ~ P1.7
;       第 17~24 片 -> P2.0 ~ P2.7
;   一轮结束后静默约 7 秒, 再开始下一轮。
;   把观察结果填进 docs\硬件上电自检清单.md 的表格里。
;
; 安全说明 (重要)
;   1) P0 在 8051 上是开漏口: 写 1 只是"放开", 不主动输出高电平。所以探测
;      P0 时表现为"每 125ms 被拉低一次", 只能点亮低电平有效的负载(如共阳
;      数码管的段选)。若某个器件接在 P0 且是高电平有效, 它在探测中不会
;      动作, 这是正常的, 不要据此判定引脚虚焊。
;   2) P3 口不参与探测: P3.0/P3.1 是 CH340 下载串口, P3.2 接 0038 红外
;      接收头输出, 若对外驱动会与接收头输出级抢电流, 故跳过。
;   3) 4Hz 方波下电机会轻微正反抖动、蜂鸣器会发出"哒哒"声, 均属正常现象,
;      不会损坏 L293D 或电机。
;   4) 本程序只输出 I/O, 不驱动任何高压, 首次上电测试是安全的。
;=========================================================================

;-------------------------------------------------------------------------
; 寄存器分配 (全程序统一, 避免互相破坏)
;   R7 : 当前引脚的位掩码 (01H,02H,...80H)
;   R6 : 端口号          (0=P0, 1=P1, 2=P2)
;   R5 : 当前引脚为低、其余引脚为高的输出图案
;   R4 : 半周期计数 (D_HALF 的循环次数)
;   R1,R2 : D_HALF 延时循环用
;-------------------------------------------------------------------------

            ORG     0000H
            LJMP    MAIN                    ; 复位向量

            ORG     0030H
;-------------------------------------------------------------------------
; 主程序: 起始静默 -> 逐口逐位探测 -> 一轮结束静默 -> 无限循环
;-------------------------------------------------------------------------
MAIN:
            MOV     SP,     #60H
            MOV     P0,     #0FFH           ; P0: 开漏, 写 1 = 放开
            MOV     P1,     #0FFH           ; P1/P2: 写 1 = 高电平(不动作)
            MOV     P2,     #0FFH

NEXT_ROUND:
            MOV     R4,     #24             ; 起始静默 24 个半周期 = 3 秒
            ACALL   SILENCE

            MOV     R6,     #0              ; 从 P0 开始

NEXT_PORT:
            MOV     R7,     #01H            ; 位掩码从 bit0 开始

NEXT_BIT:
            ACALL   PROBE_BIT               ; 该引脚输出 4 秒方波
            MOV     R4,     #16             ; 脚间静默 16 个半周期 = 2 秒
            ACALL   SILENCE
            MOV     A,      R7
            RL      A                       ; 掩码左移: bit0 -> bit7
            MOV     R7,     A
            JNZ     NEXT_BIT                ; 8 位走完后 A 正好变成 0

            INC     R6
            CJNE    R6,     #3,     NEXT_PORT   ; P0/P1/P2 三个口

            MOV     R4,     #40             ; 一轮结束静默 5 秒
            ACALL   SILENCE
            SJMP    NEXT_ROUND              ; 回到起点, 重新开始观察

;-------------------------------------------------------------------------
; PROBE_BIT: 让 R6 指定端口的 R7 所指引脚, 输出约 4 秒的 4Hz 方波
;   其余引脚保持"不动作"电平 (1), 因此同一端口上的其它负载不受影响。
;   入口: R6=端口号, R7=位掩码      出口: 无
;-------------------------------------------------------------------------
PROBE_BIT:
            MOV     A,      #0FFH
            XRL     A,      R7              ; 目标位变 0, 其余位保持 1
            MOV     R5,     A
            MOV     R4,     #32             ; 32 个半周期 = 16 周期 = 4 秒
PB_LOOP:
            MOV     A,      R5
            ACALL   PORT_OUT                ; 目标引脚拉低
            ACALL   D_HALF
            MOV     A,      #0FFH
            ACALL   PORT_OUT                ; 目标引脚放开/拉高
            ACALL   D_HALF
            DJNZ    R4,     PB_LOOP
            RET

;-------------------------------------------------------------------------
; PORT_OUT: 把 A 的值写到 R6 指定的端口
;   注意: 不能用 @R0 间接寻址 SFR, 所以这里用三次比较来选端口。
;   A 与 R0~R7 均不被破坏。
;-------------------------------------------------------------------------
PORT_OUT:
            CJNE    R6,     #0,     PO_P1
            MOV     P0,     A
            RET
PO_P1:
            CJNE    R6,     #1,     PO_P2
            MOV     P1,     A
            RET
PO_P2:
            MOV     P2,     A
            RET

;-------------------------------------------------------------------------
; SILENCE: 三个端口全部置"不动作"电平, 持续 R4 个半周期
;   入口: R4 = 半周期数          出口: R4 = 0
;-------------------------------------------------------------------------
SILENCE:
SIL_LOOP:
            MOV     P0,     #0FFH
            MOV     P1,     #0FFH
            MOV     P2,     #0FFH
            ACALL   D_HALF
            DJNZ    R4,     SIL_LOOP
            RET

;-------------------------------------------------------------------------
; D_HALF: 半周期延时, 12MHz 晶振下约 125ms (4Hz 方波)
;   只用 R1/R2, 不破坏其它寄存器
;-------------------------------------------------------------------------
D_HALF:
            MOV     R1,     #250
DH1:
            MOV     R2,     #250
DH2:
            DJNZ    R2,     DH2             ; 250 * 2us = 500us
            DJNZ    R1,     DH1             ; 250 * ~504us = 126ms
            RET

            END
