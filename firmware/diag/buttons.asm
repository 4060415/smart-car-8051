;=========================================================================
; buttons.asm  --  用板上按钮开车（前进 / 后退），完全不用遥控器
;-------------------------------------------------------------------------
; 目标器件 : STC89C52RC @ 11.0592MHz
; 生成工具 : Keil A51 + BL51 + OH51   ->  build.ps1 -Name buttons
;-------------------------------------------------------------------------
; 为什么要有这个程序
;   红外遥控那条链路还没验证通（遥控器 + 0038 + 解码，三个未知数叠在一起），
;   而板上就有两个按键，接在**已确认**的引脚上：
;     S4 -> P3.2（第12脚）   S3 -> P3.4（第14脚）   都是 10K 上拉，按下为低
;   用它们开车，可以**把红外整条链路先摘出去**，
;   单独验证"按钮 -> MCU -> P0 -> L293D -> 电机"这一段。
;   这一段通了，红外的问题就纯粹是"输入"的问题。
;
; 行为（按住走，松开停；这是最安全的做法）
;   按住 S4  -> 前进
;   按住 S3  -> 后退
;   两个都按  -> 停车（防止误触）
;   都不按    -> 停车
;
; 数码管指示（顺带把按钮也验证了）
;   前进   -> 数码管显示 "1"，同时 P2.0 那盏灯 D3 亮
;   后退   -> 数码管显示 "2"，D3 也亮
;   停车   -> 数码管全灭
;   所以：按按钮时数码管有反应 = 按钮读到了；没反应 = 按钮或引脚有问题。
;   这条很有用：即使轮子还是不动，也能靠数码管知道"按钮这段是好的"。
;
; 安全
;   * 松开即停，没有"锁定"状态；
;   * 两个按钮同时按 = 停车；
;   * 上电默认停车；
;   * 测试时把小车架起来。
;
; 引脚（来自 firmware\car\config.h）
;   S4 = P3.2（第12脚）    S3 = P3.4（第14脚）    按下 = 低
;   P0.0~P0.3 = L293D INPUT1~4   P0.4/P0.5 = ENA/ENB（高=使能）
;   P2.7~P2.1 = 数码管段选 a~g（共阳：写 0 点亮）  P2.0 = D3 指示灯（写 0 亮）
;
;   注意：图纸只标了 S3/S4 的位号，没标哪个是"左边的键"。
;   如果按起来觉得前后反了，把下面 CHK 那段的 FORWARD / BACK 对调即可。
;=========================================================================

; --- P0 输出图案（b0..b3=IN1..IN4, b4=ENA, b5=ENB, b6=蜂鸣器 1=静音, b7=1）---
PAT_STOP    EQU 0C0H            ; ENA/ENB 一起拉低 = 电机断电滑行
PAT_FORWARD EQU 0F5H
PAT_BACK    EQU 0FAH

; --- 数码管图案（共阳，写 0 点亮；bit0 = D3 灯，0 = 亮）---
;   bit7..bit1 = a b c d e f g
DISP_OFF    EQU 0FFH            ; 全灭
DISP_FWD    EQU 9EH             ; 数字 "1"（b+c 亮）+ D3 亮
DISP_BCK    EQU 24H             ; 数字 "2"（a+b+d+e+g 亮）+ D3 亮

; --- 动作码 ---
ACT_STOP    EQU 00H
ACT_FORWARD EQU 01H
ACT_BACK    EQU 02H

            ORG     0000H
            LJMP    MAIN

            ORG     0030H
MAIN:
            MOV     SP,     #60H
            MOV     P0,     #PAT_STOP
            MOV     P1,     #0FFH
            MOV     P2,     #DISP_OFF

;=========================================================================
; 主循环：读两个按钮 -> 决定动作 -> 应用到电机和数码管 -> 小延时去抖
;   JB  = 高电平就跳走（没按）；落在下面 = 低电平 = 按下了
;=========================================================================
BT_LOOP:
            MOV     A,      #ACT_STOP       ; 默认停车

            JB      P3.2,  BT_CHK_S3        ; S4 没按 -> 去看 S3
            JNB     P3.4,  BT_APPLY         ; S4 按了、S3 也按了 -> 保持停车
            MOV     A,      #ACT_FORWARD    ; 只有 S4 -> 前进
            SJMP    BT_APPLY

BT_CHK_S3:
            JNB     P3.4,  BT_S3_DOWN       ; S3 按了 -> 后退
            SJMP    BT_APPLY                ; 都没按 -> 停车

BT_S3_DOWN:
            MOV     A,      #ACT_BACK

BT_APPLY:
            ACALL   APPLY                   ; A = 动作码
            ACALL   D_20MS                  ; 20ms 一轮，顺便当按键去抖
            SJMP    BT_LOOP

;=========================================================================
; APPLY：动作码 -> 同时设置电机（P0）和数码管（P2）
;   入口 A = 动作码
;=========================================================================
APPLY:
            CJNE    A,      #ACT_FORWARD, AP_1
            MOV     P0,     #PAT_FORWARD
            MOV     P2,     #DISP_FWD
            RET
AP_1:       CJNE    A,      #ACT_BACK,    AP_0
            MOV     P0,     #PAT_BACK
            MOV     P2,     #DISP_BCK
            RET
AP_0:       MOV     P0,     #PAT_STOP
            MOV     P2,     #DISP_OFF
            RET

;=========================================================================
; 延时：D_1MS 用 R1/R2，D_20MS 用 R7
;   机器周期 = 12/11059200 = 1.085us
;=========================================================================
D_1MS:
            MOV     R2,     #2
D1M_1:      MOV     R1,     #230
D1M_2:      DJNZ    R1,     D1M_2
            DJNZ    R2,     D1M_1
            RET

D_20MS:
            MOV     R7,     #20
D20_1:      ACALL   D_1MS
            DJNZ    R7,     D20_1
            RET

            END
