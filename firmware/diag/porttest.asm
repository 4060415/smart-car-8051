;=========================================================================
; porttest.asm  --  电机到底挂在 P0 还是 P1？（决定性测试）
;-------------------------------------------------------------------------
; 目标器件 : STC89C52RC @ 11.0592MHz
; 生成工具 : Keil A51 + BL51 + OH51   ->  build.ps1 -Name porttest
;-------------------------------------------------------------------------
; 为什么要有这个程序
;   selftest.hex 能让轮子自己动，说明某个引脚确实驱动得了电机；
;   而 remote/diag/alive 三个程序按 config.h 去驱动 P0，全都一动不动。
;   这两件事同时成立，最可能的解释是：**电机根本不在 P0**（追线追错了）。
;
;   所以这个程序只问一个问题：驱动哪个口，轮子会动？
;
; 行为（上电即开始，永远循环，不需要任何操作）
;   安静 3s
;   阶段 A：给 **P1** 前进图案，P0 保持停车，持续 2s
;            -> 轮子**往前**转  ==>  电机在 **P1**
;   安静 3s
;   阶段 B：给 **P0** 后退图案，P1 全部放开，持续 2s
;            -> 轮子**往后**转  ==>  电机在 **P0**
;   安静 3s
;   （循环，一轮 10 秒）
;
;   两个阶段用**相反的方向**，所以不用看表、不用数秒，
;   光看轮子往哪边转就知道答案了。
;
; 三种结果的含义
;   只有阶段 A 动（往前）  -> 电机在 P1，config.h 的 P0 结论是错的
;   只有阶段 B 动（往后）  -> 电机确实在 P0，那就是我程序别的地方有问题
;   两个阶段都不动        -> 我的程序根本没在跑（不是端口的问题）
;
; 为什么用"前进/后退"图案而不是别的
;   0F5H = b0,b2 置 1、b1,b3 清 0、b4,b5 置 1
;   这两种常见的接法它都能驱动，所以怎么写都不会漏：
;     * 接法一（config.h 说的）：IN1~IN4 = b0~b3，ENA/ENB = b4/b5
;     * 接法二（旧版本的猜测）：P.0/P.1 一个电机、P.4/P.5 另一个电机
;
; 安全
;   * 会前进也会后退，**必须把小车架起来、轮子悬空**；
;   * 每个动作只持续 2 秒，看见不对随时拔 USB 断电。
;
; 引脚（来自 firmware\car\config.h，但本程序就是来检验它的）
;   P0.0~P0.3 = 疑为 L293D INPUT1~4   P0.4/P0.5 = 疑为 ENA/ENB
;=========================================================================

PAT_STOP    EQU 0C0H            ; ENA/ENB 一起拉低 = 电机断电滑行
PAT_FORWARD EQU 0F5H
PAT_BACK    EQU 0FAH

            ORG     0000H
            LJMP    MAIN

            ORG     0030H
MAIN:
            MOV     SP,     #60H
            MOV     P0,     #PAT_STOP
            MOV     P1,     #0FFH
            MOV     P2,     #0FFH

PLOOP:
            ; ---- 安静 3s：让上一段动作彻底停下，好分辨 ----
            MOV     P0,     #PAT_STOP
            MOV     P1,     #0FFH
            ACALL   D_3S

            ; ---- 阶段 A：P1 = 前进图案；P0 保持停车 ----
            MOV     P1,     #PAT_FORWARD
            ACALL   D_2S
            MOV     P1,     #0FFH

            ; ---- 安静 3s ----
            MOV     P0,     #PAT_STOP
            ACALL   D_3S

            ; ---- 阶段 B：P0 = 后退图案；P1 全部放开 ----
            MOV     P0,     #PAT_BACK
            ACALL   D_2S
            MOV     P0,     #PAT_STOP

            ; ---- 安静 3s，然后重来 ----
            ACALL   D_3S
            SJMP    PLOOP

;=========================================================================
; 延时
;   分工：D_1MS 用 R1/R2，D_100MS 用 R5，D_2S/D_3S 用 R6。互不重叠。
;   机器周期 = 12/11059200 = 1.085us
;=========================================================================
D_1MS:
            MOV     R2,     #2
D1M_1:      MOV     R1,     #230
D1M_2:      DJNZ    R1,     D1M_2
            DJNZ    R2,     D1M_1
            RET

D_100MS:
            MOV     R5,     #100
D100_1:     ACALL   D_1MS
            DJNZ    R5,     D100_1
            RET

D_2S:
            MOV     R6,     #20
D2S_1:      ACALL   D_100MS
            DJNZ    R6,     D2S_1
            RET

D_3S:
            MOV     R6,     #30
D3S_1:      ACALL   D_100MS
            DJNZ    R6,     D3S_1
            RET

            END
