;=========================================================================
; diag.asm  --  红外接收链路诊断（不用电脑、不用串口，靠轮子说话）
;-------------------------------------------------------------------------
; 目标器件 : STC89C52RC @ 11.0592MHz
; 生成工具 : Keil A51 + BL51 + OH51   ->  build.ps1
;-------------------------------------------------------------------------
; 为什么要有这个程序
;   remote.hex 烧进去后按遥控器毫无反应，而串口/蜂鸣器这两个"通常的"
;   输出通道在本工程里**从来没验证过**（见 docs\待办与风险.md B3），
;   所以没法判断"是没收到红外"还是"收到了但提示没生效"。
;   这个程序改用**电机**当显示器 —— 电机是唯一亲眼见过能动的东西。
;
; 行为（上电即开始，不需要任何电脑）
;   1) 开机自报：原地**左转 0.3s -> 停 -> 右转 0.3s -> 停**
;      -> 看到这一下，就证明"程序在跑 + L293D/P0 是通的"
;   2) 之后一直盯着 3 个脚。**必须是"先见到高电平、又变低"才算一次新活动**
;      （见下面"边沿检测"那段注释，这是为了安全）：
;        P3.3 有活动 -> 两轮**前进**抖一下     （0038 的红外输出，首选脚）
;        P3.2 有活动 -> 两轮**后退**抖一下     （备选脚；也是板上 S4 按键）
;        P3.4 有活动 -> 原地**左转**抖一下     （板上 S3 按键）
;      每个动作末尾还会让蜂鸣器"嘀"一声（20ms），顺带把蜂鸣器也验了。
;
; 怎么用它判断（这一条是重点）
;   自检：按**板上的 S4 键** -> 轮子**后退**抖一下
;         ✅ 有反应 = 程序在跑、电机通、检测链路通 -> 问题只在红外那一段
;         ❌ 没反应 = 更底层的问题（烧录/电机/程序没跑），先解决这个
;   测红外：按**遥控器**
;         -> 轮子**前进**抖 = 红外确实在 P3.3，收到了
;         -> 轮子**后退**抖 = 红外其实在 P3.2（原理图追线的引脚表错了）
;         -> **完全不动**     = 两个脚都没有信号：接收头没供电/坏了/装反，
;                               或者遥控器根本没在发（先用手机摄像头看遥控器）
;
; 安全设计（两条都是刻意的）
;   * 开机自报用**原地转向**，不会把车开走；
;   * **边沿检测**：只有当某个脚"先高后低"才算一次活动。万一下次接收头坏了、
;     输出一直卡在低电平，程序也只会一声不响地不动作，**不会一脚一脚往前冲**。
;
; 引脚（来自 firmware\car\config.h）
;   P3.2 = S4 按键（10K 上拉，按下为低）  P3.4 = S3 按键
;   P3.3 = 0038 红外输出
;   P0.0~P0.3 = L293D INPUT1~4   P0.4/P0.5 = ENA/ENB   P0.6 = 蜂鸣器(低电平响)
;=========================================================================

;-------------------------------------------------------------------------
; 一、常量
;-------------------------------------------------------------------------
; --- P0 输出图案（b0..b3=IN1..IN4, b4=ENA, b5=ENB, b6=蜂鸣器 1=静音, b7=1）---
PAT_STOP    EQU 0C0H
PAT_FORWARD EQU 0F5H
PAT_BACK    EQU 0FAH
PAT_LEFT    EQU 0F6H
PAT_RIGHT   EQU 0F9H

KICK_MS     EQU 150             ; 一次"抖一下"的时长
BEEP_CYCLES EQU 20              ; "嘀"一声 = 20 个 1kHz 周期 ≈ 20ms

;-------------------------------------------------------------------------
; 二、RAM 变量
;-------------------------------------------------------------------------
MOTPAT      DATA 30H            ; 当前 P0 图案（蜂鸣器位保持 1 = 静音）

; "武装"标志：1 = 这个脚现在是高电平，下次变低就算一次新活动
; （用位寻址区 20H~2FH，省内存也省指令）
ARMED33     BIT  20H
ARMED32     BIT  21H
ARMED34     BIT  22H

;-------------------------------------------------------------------------
; 三、复位向量
;-------------------------------------------------------------------------
            ORG     0000H
            LJMP    MAIN

;=========================================================================
; 主程序
;=========================================================================
            ORG     0030H
MAIN:
            MOV     SP,     #60H

            ; ---- 上电先停车、蜂鸣器关掉 ----
            MOV     MOTPAT, #PAT_STOP
            MOV     P0,     #PAT_STOP
            MOV     P1,     #0FFH
            MOV     P2,     #0FFH

            ; ---- 三个脚先"解除武装"：宁可漏报，也不能因为某个脚上电就是低
            ;      电平就一路误触发。等下一轮扫到它是高电平，才重新武装。----
            CLR     ARMED33
            CLR     ARMED32
            CLR     ARMED34

            ; ---- 串口 9600 8N1（有就用，没有也不影响诊断）----
            ;      注意：这里**不**开 Timer0 时基/中断 —— 诊断只需要数轮子，
            ;      少一路中断就少一种出错的可能。
            MOV     TMOD,   #20H        ; 只用 T1 方式2 做波特率
            MOV     TH1,    #0FDH
            MOV     TL1,    #0FDH
            MOV     SCON,   #50H
            MOV     PCON,   #00H
            SETB    TR1

            MOV     DPTR,   #MSG_BOOT
            ACALL   PRINT_STR

            ; ---- 开机自报：原地左转 -> 右转 ----
            MOV     A,      #PAT_LEFT
            ACALL   KICK300
            MOV     A,      #PAT_RIGHT
            ACALL   KICK300
            ACALL   MOTOR_OFF

            MOV     DPTR,   #MSG_READY
            ACALL   PRINT_STR

;=========================================================================
; 主循环：盯 P3.3 / P3.2 / P3.4 的下降沿
;
;   边沿检测的三步（每个脚都一样）：
;     ① JB <脚>, 高处   —— 现在是高电平：武装它（ARMED=1），跳到下一个脚
;     ② JNB ARMED, 下个脚 —— 现在是低，但没武装过：不是新边沿，忽略
;     ③ 剩下的情况 = 武装过、现在变低了 —— 这才是一次新活动：
;        解除武装 -> 抖一下 -> 下一个脚
;   第②步是关键：它保证一次低电平只触发一次，卡在低电平也不会反复触发。
;=========================================================================
DLOOP:
            ; ---- ① / ③ P3.3（红外首选脚）----
            JB      P3.3,   D_ARM33
            JNB     ARMED33, D_CHK32
            CLR     ARMED33
            MOV     DPTR,   #MSG_P33
            ACALL   PRINT_STR
            MOV     A,      #PAT_FORWARD
            ACALL   KICK
            SJMP    D_CHK32
D_ARM33:
            SETB    ARMED33

            ; ---- P3.2（红外备选脚 / 板上 S4 按键）----
D_CHK32:
            JB      P3.2,   D_ARM32
            JNB     ARMED32, D_CHK34
            CLR     ARMED32
            MOV     DPTR,   #MSG_P32
            ACALL   PRINT_STR
            MOV     A,      #PAT_BACK
            ACALL   KICK
            SJMP    D_CHK34
D_ARM32:
            SETB    ARMED32

            ; ---- P3.4（板上 S3 按键，纯自检用）----
D_CHK34:
            JB      P3.4,   D_ARM34
            JNB     ARMED34, DLOOP
            CLR     ARMED34
            MOV     DPTR,   #MSG_P34
            ACALL   PRINT_STR
            MOV     A,      #PAT_LEFT
            ACALL   KICK
            SJMP    DLOOP
D_ARM34:
            SETB    ARMED34
            SJMP    DLOOP

;=========================================================================
; KICK：按 A 里的图案动一下，然后停 + 嘀一声
;=========================================================================
KICK:
            MOV     MOTPAT, A
            MOV     P0,     A
            ACALL   D_150MS
            ACALL   MOTOR_OFF
            ACALL   BEEP
            RET

; KICK300：开机自报用，动 0.3s，转完停一会儿，好让两次转分得清
KICK300:
            MOV     MOTPAT, A
            MOV     P0,     A
            ACALL   D_150MS
            ACALL   D_150MS
            ACALL   MOTOR_OFF
            ACALL   D_150MS
            RET

;-------------------------------------------------------------------------
; MOTOR_OFF：电机全断电（ENA/ENB 一起拉低 = 滑行，最省电）
;-------------------------------------------------------------------------
MOTOR_OFF:
            MOV     MOTPAT, #PAT_STOP
            MOV     P0,     #PAT_STOP
            RET

;-------------------------------------------------------------------------
; BEEP：嘀一声（无源蜂鸣器要给方波；P0.6 低 = S8550 导通 = 响）
;   用 MOTPAT 做底，只翻转 b6，所以不会把电机状态搞乱。
;   只用 R7；D_500US 只用 R0，不冲突。
;-------------------------------------------------------------------------
BEEP:
            MOV     R7,     #BEEP_CYCLES
BP_LOOP:
            MOV     A,      MOTPAT
            ANL     A,      #0BFH       ; b6 清零 -> 响
            MOV     P0,     A
            ACALL   D_500US
            MOV     P0,     MOTPAT      ; b6 置 1 -> 静音
            ACALL   D_500US
            DJNZ    R7,     BP_LOOP
            RET

;=========================================================================
; 串口输出辅助
;=========================================================================
PUTCHAR:
            MOV     SBUF,   A
            JNB     TI,     $
            CLR     TI
            RET

PRINT_STR:
            CLR     A
            MOVC    A,      @A+DPTR
            JZ      PS_DONE
            INC     DPTR
            ACALL   PUTCHAR
            SJMP    PRINT_STR
PS_DONE:
            RET

;=========================================================================
; 延时
;   分工（避免踩寄存器）：D_1MS 用 R1/R2，D_150MS 用 R5，
;   D_500US 用 R0，BEEP 用 R7。互不重叠。
;   机器周期 = 12/11059200 = 1.085us
;=========================================================================
D_1MS:
            MOV     R2,     #2
D1M_1:      MOV     R1,     #230
D1M_2:      DJNZ    R1,     D1M_2
            DJNZ    R2,     D1M_1
            RET

D_150MS:
            MOV     R5,     #KICK_MS
D150_1:     ACALL   D_1MS
            DJNZ    R5,     D150_1
            RET

D_500US:
            MOV     R0,     #229
D500_1:     DJNZ    R0,     D500_1
            RET

;=========================================================================
; 字符串（纯 ASCII：串口助手/终端里都不会乱码）
;=========================================================================
MSG_BOOT:
            DB  0DH,0AH,'=== IR LINK DIAG ===',0DH,0AH
            DB  'power-on: spin LEFT then RIGHT (proves program + motor)',0DH,0AH
            DB  'then: P3.3->FWD kick | P3.2->BACK kick | P3.4->LEFT spin',0DH,0AH,0

MSG_READY:  DB  'ready. press S4 on the board as a self-test.',0DH,0AH,0
MSG_P33:    DB  0DH,0AH,'P3.3 EDGE -> FWD   (0038 IR, first choice)',0DH,0AH,0
MSG_P32:    DB  0DH,0AH,'P3.2 EDGE -> BACK  (IR alt / board key S4)',0DH,0AH,0
MSG_P34:    DB  0DH,0AH,'P3.4 EDGE -> LEFT  (board key S3)',0DH,0AH,0

            END
