;=========================================================================
; sweep.asm  --  逐个输出通道点名："我的程序到底跑没跑？"
;-------------------------------------------------------------------------
; 目标器件 : STC89C52RC @ 11.0592MHz
; 生成工具 : Keil A51 + BL51 + OH51   ->  build.ps1 -Name sweep
;-------------------------------------------------------------------------
; 为什么要有这个程序
;   porttest.hex 已经确认烧进去了（Verify OK），但它驱动 P0/P1 之后
;   完全没有反应。这有两种可能：
;     (a) 程序在跑，只是电机不在 P0/P1 上（或电机没电）
;     (b) 程序根本就没执行
;   要分开这两者，必须换一个**跟电机完全无关**的输出通道。
;   最合适的就是**数码管 SM1（P2）**——它亮不亮，一眼就能看见。
;
;   所以这个程序挨个点名：数码管 -> P0 -> P1 -> 蜂鸣器。
;   哪个阶段有反应，就说明那一路是通的。
;
; 行为（上电即开始，永远循环，一轮 28 秒）
;   阶段 1（5 秒）：**P2 全亮 / 全灭 交替闪**（2Hz）
;                   -> 数码管闪  = 程序在跑！这是最关键的一条
;   安静 2 秒
;   阶段 2（5 秒）：P0 前进图案 / 停车 交替（2Hz）
;                   -> 轮子突突  = 电机在 P0
;   安静 2 秒
;   阶段 3（5 秒）：P1 前进图案 / 放开 交替（2Hz）
;                   -> 轮子突突  = 电机在 P1
;   安静 2 秒
;   阶段 4（5 秒）：蜂鸣器 响 0.25s / 停 0.25s
;                   -> 听到"嘀嘀嘀" = 蜂鸣器好
;   安静 2 秒，然后从阶段 1 重来
;
; 怎么判断（按重要程度排序）
;   1) **数码管闪过** -> 程序在跑、烧录没问题。那"轮子不动"就纯粹是
;      电机那一路的事（端口不对 / 没供电），跟程序的执行无关。
;   2) 数码管完全不闪 -> 程序没在执行（或数码管本身不亮），
;      那就不是端口和电机的问题，方向要换。
;   3) 哪个阶段轮子动了    -> 电机在那个口上。
;   4) 蜂鸣器响不响        -> 顺带验证蜂鸣器。
;
; 注意
;   * 交替频率是 2Hz（0.25 秒一换），不是常亮。**是"闪"，不是"一直亮"**；
;   * 阶段 2/3 会让轮子转，**必须把小车架起来**；
;   * 阶段 1 驱动 P2 时 P0 保持停车，阶段 2/3 时 P2 保持全灭，互不干扰。
;
; 引脚（来自 firmware\car\config.h）
;   P2.1~P2.7 = 数码管段选 a~g（共阳：写 0 点亮）   P0.6 = 蜂鸣器（低电平响）
;   P0.0~P0.3 = 疑为 L293D INPUT1~4   P0.4/P0.5 = 疑为 ENA/ENB
;=========================================================================

PAT_STOP    EQU 0C0H            ; 电机断电（ENA/ENB 一起拉低）
PAT_FORWARD EQU 0F5H
PAT_P2OFF   EQU 0FFH            ; 共阳段选：全 1 = 全灭
PAT_P2ON    EQU 00H             ; 全 0 = 全亮

PHASE_N     EQU 10              ; 每个阶段 10 × 0.5s = 5 秒
GAP_100MS   EQU 20              ; 阶段之间安静 20 × 100ms = 2 秒

            ORG     0000H
            LJMP    MAIN

            ORG     0030H
MAIN:
            MOV     SP,     #60H
            MOV     P0,     #PAT_STOP
            MOV     P1,     #0FFH
            MOV     P2,     #PAT_P2OFF

SW_LOOP:
            ; ---- 阶段 1：数码管全亮 / 全灭 ----
            MOV     R7,     #PHASE_N
SW1:        MOV     P2,     #PAT_P2ON
            ACALL   D_250MS
            MOV     P2,     #PAT_P2OFF
            ACALL   D_250MS
            DJNZ    R7,     SW1
            ACALL   D_GAP

            ; ---- 阶段 2：P0 前进 / 停车 ----
            MOV     R7,     #PHASE_N
SW2:        MOV     P0,     #PAT_FORWARD
            ACALL   D_250MS
            MOV     P0,     #PAT_STOP
            ACALL   D_250MS
            DJNZ    R7,     SW2
            ACALL   D_GAP

            ; ---- 阶段 3：P1 前进 / 放开 ----
            MOV     R7,     #PHASE_N
SW3:        MOV     P1,     #PAT_FORWARD
            ACALL   D_250MS
            MOV     P1,     #0FFH
            ACALL   D_250MS
            DJNZ    R7,     SW3
            ACALL   D_GAP

            ; ---- 阶段 4：蜂鸣器 ----
            ;   响 0.25s（250 个 1kHz 周期）再停 0.25s，重复 10 次
            MOV     R7,     #PHASE_N
SW4:        MOV     R4,     #250
SW4A:       MOV     A,      #PAT_STOP
            ANL     A,      #0BFH       ; b6 清 0 -> 蜂鸣器响
            MOV     P0,     A
            ACALL   D_500US
            MOV     P0,     #PAT_STOP
            ACALL   D_500US
            DJNZ    R4,     SW4A
            ACALL   D_250MS
            DJNZ    R7,     SW4
            ACALL   D_GAP

            SJMP    SW_LOOP

;=========================================================================
; 延时
;   寄存器分工（互不重叠）：
;     D_1MS   用 R1/R2      D_100MS 用 R5
;     D_250MS 用 R4         D_GAP   用 R6
;     D_500US 用 R0         阶段计数用 R7
;   机器周期 = 12/11059200 = 1.085us
;=========================================================================
D_1MS:
            MOV     R2,     #2
D1M_1:      MOV     R1,     #230
D1M_2:      DJNZ    R1,     D1M_2
            DJNZ    R2,     D1M_1
            RET

D_100MS:
            MOV     R5,     #100
D100_1:     ACALL   D_1MS
            DJNZ    R5,     D100_1
            RET

D_250MS:
            MOV     R4,     #250
D250_1:     ACALL   D_1MS
            DJNZ    R4,     D250_1
            RET

D_GAP:
            MOV     R6,     #GAP_100MS
DGAP_1:     ACALL   D_100MS
            DJNZ    R6,     DGAP_1
            RET

D_500US:
            MOV     R0,     #229
D500_1:     DJNZ    R0,     D500_1
            RET

            END
