;=========================================================================
; alive.asm  --  最小"你还活着吗"测试
;-------------------------------------------------------------------------
; 目标器件 : STC89C52RC @ 11.0592MHz
; 生成工具 : Keil A51 + BL51 + OH51   ->  build.ps1 -Name alive
;-------------------------------------------------------------------------
; 为什么要写它
;   remote.hex 和 diag.hex 都"没反应"。这两个程序开机第一件事都是往串口
;   打一行横幅，而串口发送用的是 `JNB TI, $` —— 万一串口因为任何原因发不
;   出去，程序就会**永远卡在那里**，后面的电机动作一行都执行不到。
;
;   所以这个版本把**串口、中断、定时器、所有输入**统统删掉，只留一件事：
;   不停地让轮子转。全部代码不到 100 字节，没有任何可以出错的余地。
;
; 行为（上电即开始，永远循环，不需要任何操作）
;   前进 0.4s -> 停 0.4s -> 后退 0.4s -> 停 0.4s
;   -> 左转 0.4s -> 停 0.4s -> 右转 0.4s -> 停 0.4s   （然后重复）
;
; 怎么判断
;   轮子动  -> 硬件、烧录、电机全部正常，问题一定在**我写的代码**里
;              （那就说明是串口/中断那段把程序卡住了，我知道往哪查）
;   轮子不动 -> 根本不是软件的事：烧录没成功、供电不对、或电机这路有问题
;
; 安全
;   * 会前进也会后退，所以**必须把小车架起来、轮子悬空**；
;   * 模式里含 ENA/ENB 拉高的四个方向，四个方向都试到了。
;
; 引脚（来自 firmware\car\config.h）
;   P0.0~P0.3 = L293D INPUT1~4   P0.4/P0.5 = ENA/ENB   P0.6 = 蜂鸣器(1=静音)
;=========================================================================

; --- P0 输出图案（b0..b3=IN1..IN4, b4=ENA, b5=ENB, b6=蜂鸣器 1=静音, b7=1）---
PAT_STOP    EQU 0C0H
PAT_FORWARD EQU 0F5H
PAT_BACK    EQU 0FAH
PAT_LEFT    EQU 0F6H
PAT_RIGHT   EQU 0F9H

STEP_MS     EQU 400             ; 每个动作持续 400ms

            ORG     0000H
            LJMP    MAIN

            ORG     0030H
MAIN:
            MOV     SP,     #60H
            ; P0 是开漏口：写 1 只是"放开"，靠板上 10K 排阻拉高。
            ; 这里不碰 P0 的其它位意义，只写完整图案。
            MOV     P0,     #PAT_STOP
            MOV     P1,     #0FFH
            MOV     P2,     #0FFH

LOOP:
            MOV     P0,     #PAT_FORWARD
            ACALL   D_STEP
            MOV     P0,     #PAT_STOP
            ACALL   D_STEP
            MOV     P0,     #PAT_BACK
            ACALL   D_STEP
            MOV     P0,     #PAT_STOP
            ACALL   D_STEP
            MOV     P0,     #PAT_LEFT
            ACALL   D_STEP
            MOV     P0,     #PAT_STOP
            ACALL   D_STEP
            MOV     P0,     #PAT_RIGHT
            ACALL   D_STEP
            MOV     P0,     #PAT_STOP
            ACALL   D_STEP
            SJMP    LOOP

;-------------------------------------------------------------------------
; D_STEP：约 400ms（200 × 2ms），用 R5；D_2MS 只用 R1/R2，互不冲突
;   机器周期 = 12/11059200 = 1.085us
;-------------------------------------------------------------------------
D_STEP:
            MOV     R5,     #200
DS_1:       ACALL   D_2MS
            DJNZ    R5,     DS_1
            RET

D_2MS:
            MOV     R2,     #4
D2M_1:      MOV     R1,     #230
D2M_2:      DJNZ    R1,     D2M_2
            DJNZ    R2,     D2M_1
            RET

            END
